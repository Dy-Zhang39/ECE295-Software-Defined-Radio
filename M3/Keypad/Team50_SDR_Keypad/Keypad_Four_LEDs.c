/*
 * Team50_SDR_Keypad.c
 *
 * Created: 3/29/2022 10:06:10 AM
 * Author : ECE295_Student
 */ 

#define F_CPU 8000000
#include <avr/io.h>
#include <util/delay.h>

int main(void)
{
    /* Replace with your application code */
	DDRB = 0xf0; //Set ports B 4-7 as output, 0-3 as input
	DDRD = 0x3c; //Set port D5 as output for test LED
	
	volatile uint8_t PB_value;
	volatile uint8_t PD_value;
    while (1) 
    {
		PB_value = PINB;
		PD_value = PIND;
		PORTB = 0xf0;
		
		if((PB_value & 0xf) != 0){
			_delay_ms(100);
			if((PB_value & 0xf) != 0){
				PORTD = (PIND & 0xc3) | (PINB & 0xf)<<2;
			}
			else {
				PORTD = (PIND & 0xc3) | 0;
			}
		}
		else {
			PORTD = (PIND & 0xc3) | 0;
		}
    }
}



























































































































































































































































































































































































































































































































































































































































































































































































































































































































































































